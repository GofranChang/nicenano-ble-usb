## boards/arm/nice_nano_v2_bridge/Kconfig.board
```kconfig
config BOARD_NICE_NANO_V2_BRIDGE
    bool "nice!nano v2 standalone BLE USB bridge"
    depends on SOC_NRF52840_QIAA
```

## boards/arm/nice_nano_v2_bridge/Kconfig.defconfig
```kconfig
if BOARD_NICE_NANO_V2_BRIDGE
config BOARD
    default "nice_nano_v2_bridge"
config USB_NRFX
    default y if USB_DEVICE_STACK
config BT_CTLR
    default y if BT
endif
```
